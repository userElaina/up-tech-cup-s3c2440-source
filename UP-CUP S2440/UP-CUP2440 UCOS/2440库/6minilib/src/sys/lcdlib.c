/***************************************************************************\
	Copyright (c) 2004-2007 threewater@up-tech.com, All rights reserved.
	by threewter	2004.4.26
\***************************************************************************/
	

/***************************************************************************\
    #说明: 液晶显示驱动程序
    #接口函数
		void LCD_Cls(); //文本模式下清除屏幕?
		void LCD_ChangeMode(U8 mode);
		void LCD_Refresh();
		void LCD_printf(const char *format,...);
		void LCD_TestShow();
	----------------------------------  Bug  --------------------------------------

	----------------------------------  TODO list  --------------------------------------

	----------------------------------修正--------------------------------------
	2004-5-9	创建

\***************************************************************************/
#include "../inc/sys/lib.h"
#include "../inc/macro.h"
#include "../inc/drv/lcd.h"
#include <stdarg.h>
#include <stdio.h>
#include <string.h>

//////////////////LCD Information//////////////
#define LCDTxtMode_TxtWidth		8
#define LCDTxtMode_TxtHeight	12

//每列字符数
#define LCDColumn	(LCDWIDTH/LCDTxtMode_TxtWidth)
//每行字符数
#define LCDRow		(LCDHEIGHT/LCDTxtMode_TxtHeight)


U32* pLCDFB=0;
static int LCDdspMode=DspTxtMode;
//////////////12x8字模/////////////////
U8 LCDTxtData[128][12]={0x0, 0x0, 0x0, 0x0, 0x0, 0x0, 0x0, 0x0, 0x0, 0x0, 0x0, 0x0, 
	0x0, 0x0, 0x0, 0x0, 0x0, 0x0, 0x1c,0x10,0x10,0x10,0x10,0x10,
	0x0, 0x0, 0x0, 0x0, 0x0, 0x0, 0xf0,0x10,0x10,0x10,0x10,0x10,
	0x10,0x10,0x10,0x10,0x10,0x10,0x1c,0x0, 0x0, 0x0, 0x0, 0x0, 
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	0x40,0xa4,0x18,0x0, 0x0, 0x0, 0x0, 0x0, 0x0, 0x0, 0x0, 0x0, 
};

void LCDLib_Init(unsigned int*pbuffer)
{
	pLCDFB=pbuffer;
	LCD_printf("LCD initialization is OK\n");
	LCD_printf("Text Mode\n");
}

U8 LCDTxtBuffer[LCDRow][LCDColumn];
int LCDCurrentPrnTxt=0;	//打印文本所在的行
U8 LCDIsprnOverPage=FALSE;	//是否滚动屏幕

void LCD_TxtRefresh(int LCDCurrentDspTxt)
{
	int i,j,showrow;
	unsigned int data;
	U8 txtdata;

#if (LCDCOLOR==MONO)
	U32 temp=0;
	int k;

	for(j=0;j<LCDHEIGHT;j++){
		for(i=0;i<LCDColumn;i+=4){
			data=0;
			showrow=LCDCurrentDspTxt+j/LCDTxtMode_TxtHeight;
			if(showrow>LCDRow-1)
				showrow-=LCDRow;
			temp=0;
			for(k=0;k<4;k++){
				txtdata=LCDTxtBuffer[showrow][i+k];
				if(txtdata>128)
					txtdata=' ';
				txtdata=LCDTxtData[txtdata][j%LCDTxtMode_TxtHeight];
				temp<<=8;
				temp|=txtdata;
			}
			/*for(k=7;k>=0;k--){
				data<<=4;
				data|=((txtdata>>k)&0x1)*0xf;
			}*/
			*(pLCDFB+i/4+j*10)=temp;
		}
	}
#elif (LCDCOLOR==GRAY16)
	int k;
	for(j=0;j<LCDHEIGHT;j++){
		for(i=0;i<LCDColumn;i++){
			data=0;
			showrow=LCDCurrentDspTxt+j/LCDTxtMode_TxtHeight;
			if(showrow>LCDRow-1)
				showrow-=LCDRow;
			txtdata=LCDTxtBuffer[showrow][i];
			if(txtdata>=128)
				txtdata=' ';
			txtdata=LCDTxtData[txtdata][j%LCDTxtMode_TxtHeight];
			for(k=7;k>=0;k--){
				data<<=4;
				data|=((txtdata>>k)&0x1)*0xf;
			}
		#if(LCDDATA_ORDER == LCDDATA_SWAPW)	//高低字交换
			data=(data>>16)|(data<<16);
		#endif
			*(pLCDFB+i+j*40)=data;
		}
	}
#elif (LCDCOLOR==COLOR256)
	unsigned char *pLCDBuffer=(unsigned char *)pLCDFB;
	
	for(j=0;j<LCDHEIGHT;j++){
		for(i=0;i<LCDColumn;i++){
			data=0;
			showrow=LCDCurrentDspTxt+j/LCDTxtMode_TxtHeight;
			if(showrow>LCDRow-1)
				showrow-=LCDRow;
			txtdata=LCDTxtBuffer[showrow][i];
			if(txtdata>=128)
				txtdata=' ';
			txtdata=LCDTxtData[txtdata][j%LCDTxtMode_TxtHeight];

	#if(LCDDATA_ORDER == LCDDATA_SWAPW)	//高低字交换
			*pLCDBuffer=((txtdata>>7)&0x1)*0xff;
			pLCDBuffer++;
			*pLCDBuffer=((txtdata>>6)&0x1)*0xff;
			pLCDBuffer++;
			*pLCDBuffer=((txtdata>>5)&0x1)*0xff;
			pLCDBuffer++;
			*pLCDBuffer=((txtdata>>4)&0x1)*0xff;
			pLCDBuffer++;
			*pLCDBuffer=((txtdata>>3)&0x1)*0xff;
			pLCDBuffer++;
			*pLCDBuffer=((txtdata>>2)&0x1)*0xff;
			pLCDBuffer++;
			*pLCDBuffer=((txtdata>>1)&0x1)*0xff;
			pLCDBuffer++;
			*pLCDBuffer=((txtdata>>0)&0x1)*0xff;
			pLCDBuffer++;
	#else
			*pLCDBuffer=((txtdata>>4)&0x1)*0xff;
			pLCDBuffer++;
			*pLCDBuffer=((txtdata>>5)&0x1)*0xff;
			pLCDBuffer++;
			*pLCDBuffer=((txtdata>>6)&0x1)*0xff;
			pLCDBuffer++;
			*pLCDBuffer=((txtdata>>7)&0x1)*0xff;
			pLCDBuffer++;
			*pLCDBuffer=((txtdata>>0)&0x1)*0xff;
			pLCDBuffer++;
			*pLCDBuffer=((txtdata>>1)&0x1)*0xff;
			pLCDBuffer++;
			*pLCDBuffer=((txtdata>>2)&0x1)*0xff;
			pLCDBuffer++;
			*pLCDBuffer=((txtdata>>3)&0x1)*0xff;
			pLCDBuffer++;
	#endif
		}
	}

#elif (LCDCOLOR==COLOR64K)
	unsigned short int *pLCDBuffer=(unsigned short int *)pLCDFB;
	
	for(j=0;j<LCDHEIGHT;j++){
		for(i=0;i<LCDColumn;i++){
			data=0;
			showrow=LCDCurrentDspTxt+j/LCDTxtMode_TxtHeight;
			if(showrow>LCDRow-1)
				showrow-=LCDRow;
			txtdata=LCDTxtBuffer[showrow][i];
			if(txtdata>=128)
				txtdata=' ';
			txtdata=LCDTxtData[txtdata][j%LCDTxtMode_TxtHeight];

			*pLCDBuffer=((txtdata>>7)&0x1)*0xffff;
			pLCDBuffer++;
			*pLCDBuffer=((txtdata>>6)&0x1)*0xffff;
			pLCDBuffer++;
			*pLCDBuffer=((txtdata>>5)&0x1)*0xffff;
			pLCDBuffer++;
			*pLCDBuffer=((txtdata>>4)&0x1)*0xffff;
			pLCDBuffer++;
			*pLCDBuffer=((txtdata>>3)&0x1)*0xffff;
			pLCDBuffer++;
			*pLCDBuffer=((txtdata>>2)&0x1)*0xffff;
			pLCDBuffer++;
			*pLCDBuffer=((txtdata>>1)&0x1)*0xffff;
			pLCDBuffer++;
			*pLCDBuffer=((txtdata>>0)&0x1)*0xffff;
			pLCDBuffer++;
		}
	}
#endif
}

void LCD_printf(const char *format,...)
{
	int i,j=0;
	int LCDCurrentDspTxt=0;
	va_list v_list;
	char *ptr;
	static char tbuf[256];

	va_start(v_list, format);     // Initialize variable arguments. 
	vsprintf(tbuf, format, v_list ); 
	va_end(v_list);

	ptr= tbuf;

	if(LCDdspMode!=DspTxtMode)
		return;

	/*格式化字符串*/
	for(i=0;ptr[i]!=0;i++){
		if(ptr[i]=='\n'){	//换行
			LCDCurrentPrnTxt++;
			if(LCDCurrentPrnTxt>LCDRow-1){
				LCDCurrentPrnTxt-=LCDRow;
				LCDIsprnOverPage=TRUE;
			}
			if(LCDIsprnOverPage)
				LCDCurrentDspTxt=LCDCurrentPrnTxt;

			for(;j<LCDColumn;j++)	//补齐空格
				LCDTxtBuffer[LCDCurrentPrnTxt][j]=0;
			j=0;
		}
		else{
			if(j<LCDColumn)
				LCDTxtBuffer[LCDCurrentPrnTxt][j++]=ptr[i];
		}
	}
	LCD_TxtRefresh(LCDCurrentDspTxt);
}

void LCD_ChangeMode(int mode)
{
	LCDdspMode=mode;
}

#if (USE_MINIGUI==0) && (DIRECT_DISPLAY==0)
extern U32 LCDBuffer[LCDHEIGHT][LCDWIDTH];
//extern U32 *LCDBuffer[];

void LCD_Refresh()
{
	int i,j;
	U32 lcddata;
	U32 pixcolor;	//一个像素点的颜色
	U32 *p=pLCDFB;
	U8* pbuf=(U8*)LCDBuffer[0];

	if(LCDdspMode!=DspGraMode)
		return;

#if (LCDCOLOR==GRAY16)
	for(i=0;i<LCDWIDTH*LCDHEIGHT/8;i++){
		lcddata=0;
		for(j=28;j>=0;j-=4){
			pixcolor=0xf-(pbuf[0]+pbuf[1]+pbuf[2])/48;	//变换RGB色彩为灰度
			lcddata|=pixcolor<<j;
			pbuf+=4;
		}

		#if(LCDDATA_ORDER == LCDDATA_SWAPW)	//高低字交换
			lcddata=(lcddata>>16)|(lcddata<<16);
		#endif

		*(pLCDFB+i)=lcddata;
	}
#elif (LCDCOLOR==COLOR256)

	for(i=0;i<LCDWIDTH*LCDHEIGHT/4;i++){
		lcddata=0;
	#if(LCDDATA_ORDER == LCDDATA_SWAPW)	//高低字交换
		for(j=0;j<32;j+=8){
			pixcolor=(pbuf[0]&0xe0)|((pbuf[1]>>3)&0x1c)|(pbuf[2]>>6);	//变换RGB
				//		R			G					B
			lcddata|=pixcolor<<j;
			pbuf+=4;
		}
	#else
		for(j=24;j>=0;j-=8){
			pixcolor=(pbuf[0]&0xe0)|((pbuf[1]>>3)&0x1c)|(pbuf[2]>>6);	//变换RGB
				//		R			G					B
			lcddata|=pixcolor<<j;
			pbuf+=4;
		}
	#endif
		*p=lcddata;
		p++;
	}
#elif (LCDCOLOR==COLOR64K)
//#define RGB888_RGB565(p)	((p[0]>>3)|((p[1]&0xfc)<<3)|((p[2]&0xf8)<<8))
				//		R			G					B
#define RGB888_RGB565(p)	((p[2]>>3)|((p[1]&0xfc)<<3)|((p[0]&0xf8)<<8))

	for(i=0;i<LCDWIDTH*LCDHEIGHT/2;i++){
		pixcolor=RGB888_RGB565(pbuf);	//变换RGB
		lcddata=pixcolor;
		pbuf+=4;

		pixcolor=RGB888_RGB565(pbuf);	//变换RGB
		lcddata|=pixcolor<<16;
		pbuf+=4;

		*p=lcddata;
		p++;
	}

#endif
}

#endif //#if (USE_MINIGUI==0) && (DIRECT_DISPLAY==0)

//文本模式下清除屏幕?
void LCD_Cls() 
{
	LCDCurrentPrnTxt=0,	//打印文本所在的行
	LCDIsprnOverPage=FALSE;

	memset(LCDTxtBuffer,0,LCDRow*LCDColumn);
}

void LCD_TestShow()
{
	int i,j;
	for(j=0;j<LCDHEIGHT;j+=16){
		for(i=0;i<40;i++){
			*(pLCDFB+0+i+j*40)=0xffffffff;
			*(pLCDFB+40+i+j*40)=0xeeeeeeee;
			*(pLCDFB+80+i+j*40)=0xdddddddd;
			*(pLCDFB+120+i+j*40)=0xcccccccc;
			*(pLCDFB+160+i+j*40)=0xbbbbbbbb;
			*(pLCDFB+200+i+j*40)=0xaaaaaaaa;
			*(pLCDFB+240+i+j*40)=0x99999999;
			*(pLCDFB+280+i+j*40)=0x88888888;
			*(pLCDFB+320+i+j*40)=0x77777777;
			*(pLCDFB+360+i+j*40)=0x66666666;
			*(pLCDFB+400+i+j*40)=0x55555555;
			*(pLCDFB+440+i+j*40)=0x44444444;
			*(pLCDFB+480+i+j*40)=0x33333333;
			*(pLCDFB+520+i+j*40)=0x22222222;
			*(pLCDFB+560+i+j*40)=0x11111111;
			*(pLCDFB+600+i+j*40)=0x00000000;
		}
	}
}

